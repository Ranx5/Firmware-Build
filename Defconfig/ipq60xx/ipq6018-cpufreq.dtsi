// SPDX-License-Identifier: GPL-2.0-only
// Overclock CPU frequency to 1.6GHz
&cpu_opp_table {
	opp-1608000000 {
		opp-supported-hw = <0x3>;
	};
};
&nss_region {
	nss@40000000 {
		no-map;
		reg = <0x0 0x40000000 0x0 0x01000000>;
	};
};
